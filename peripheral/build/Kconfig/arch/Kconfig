## peripheral/build/Kconfig/soc/Kconfig.tmp
```kconfig
# Load Zephyr SoC Kconfig descriptions.
osource "/home/hadoop/zephyresp/zephyr/soc/xlnx/zynqmp/Kconfig"
osource "/home/hadoop/zephyresp/zephyr/soc/xlnx/zynq7000/Kconfig"
osource "/home/hadoop/zephyresp/zephyr/soc/xlnx/versalnet/Kconfig"
osource "/home/hadoop/zephyresp/zephyr/soc/xlnx/versal2/Kconfig"
osource "/home/hadoop/zephyresp/zephyr/soc/xlnx/versal/Kconfig"
osource "/home/hadoop/zephyresp/zephyr/soc/xen/Kconfig"
osource "/home/hadoop/zephyresp/zephyr/soc/wch/ch32v/Kconfig"
osource "/home/hadoop/zephyresp/zephyr/soc/ti/simplelink/Kconfig"
osource "/home/hadoop/zephyresp/zephyr/soc/ti/mspm0/Kconfig"
osource "/home/hadoop/zephyresp/zephyr/soc/ti/lm3s6965/Kconfig"
osource "/home/hadoop/zephyresp/zephyr/soc/ti/k3/Kconfig"
osource "/home/hadoop/zephyresp/zephyr/soc/telink/tlsr/Kconfig"
osource "/home/hadoop/zephyresp/zephyr/soc/syna/sr100/Kconfig"
osource "/home/hadoop/zephyresp/zephyr/soc/starfive/jh71xx/Kconfig"
osource "/home/hadoop/zephyresp/zephyr/soc/st/stm32/Kconfig"
osource "/home/hadoop/zephyresp/zephyr/soc/snps/qemu_arc/Kconfig"
osource "/home/hadoop/zephyresp/zephyr/soc/snps/nsim/arc_v/Kconfig"
osource "/home/hadoop/zephyresp/zephyr/soc/snps/nsim/arc_classic/Kconfig"
osource "/home/hadoop/zephyresp/zephyr/soc/snps/hsdk4xd/Kconfig"
osource "/home/hadoop/zephyresp/zephyr/soc/snps/hsdk/Kconfig"
osource "/home/hadoop/zephyresp/zephyr/soc/snps/emsk/Kconfig"
osource "/home/hadoop/zephyresp/zephyr/soc/snps/emsdp/Kconfig"
osource "/home/hadoop/zephyresp/zephyr/soc/snps/arc_iot/Kconfig"
osource "/home/hadoop/zephyresp/zephyr/soc/silabs/Kconfig"
osource "/home/hadoop/zephyresp/zephyr/soc/sifli/sf32/Kconfig"
osource "/home/hadoop/zephyresp/zephyr/soc/sifive/sifive_freedom/Kconfig"
osource "/home/hadoop/zephyresp/zephyr/soc/sensry/Kconfig"
osource "/home/hadoop/zephyresp/zephyr/soc/rockchip/Kconfig"
osource "/home/hadoop/zephyresp/zephyr/soc/renode/riscv_virtual/Kconfig"
osource "/home/hadoop/zephyresp/zephyr/soc/renode/cortex_r8_virtual/Kconfig"
osource "/home/hadoop/zephyresp/zephyr/soc/renesas/smartbond/Kconfig"
osource "/home/hadoop/zephyresp/zephyr/soc/renesas/rz/Kconfig"
osource "/home/hadoop/zephyresp/zephyr/soc/renesas/rx/Kconfig"
osource "/home/hadoop/zephyresp/zephyr/soc/renesas/rcar/Kconfig"
osource "/home/hadoop/zephyresp/zephyr/soc/renesas/ra/Kconfig"
osource "/home/hadoop/zephyresp/zephyr/soc/realtek/fingerprint/Kconfig"
osource "/home/hadoop/zephyresp/zephyr/soc/realtek/ec/Kconfig"
osource "/home/hadoop/zephyresp/zephyr/soc/realtek/bee/Kconfig"
osource "/home/hadoop/zephyresp/zephyr/soc/realtek/ameba/Kconfig"
osource "/home/hadoop/zephyresp/zephyr/soc/raspberrypi/rpi_pico/Kconfig"
osource "/home/hadoop/zephyresp/zephyr/soc/quicklogic/eos_s3/Kconfig"
osource "/home/hadoop/zephyresp/zephyr/soc/qemu/virt_riscv/Kconfig"
osource "/home/hadoop/zephyresp/zephyr/soc/qemu/or1k/Kconfig"
osource "/home/hadoop/zephyresp/zephyr/soc/qemu/malta/Kconfig"
osource "/home/hadoop/zephyresp/zephyr/soc/openisa/rv32m1/Kconfig"
osource "/home/hadoop/zephyresp/zephyr/soc/openhwgroup/cva6/Kconfig"
osource "/home/hadoop/zephyresp/zephyr/soc/oct/osd32mp15x/Kconfig"
osource "/home/hadoop/zephyresp/zephyr/soc/nxp/s32/Kconfig"
osource "/home/hadoop/zephyresp/zephyr/soc/nxp/rw/Kconfig"
osource "/home/hadoop/zephyresp/zephyr/soc/nxp/mcx/Kconfig"
osource "/home/hadoop/zephyresp/zephyr/soc/nxp/lpc/Kconfig"
osource "/home/hadoop/zephyresp/zephyr/soc/nxp/layerscape/Kconfig"
osource "/home/hadoop/zephyresp/zephyr/soc/nxp/kinetis/Kconfig"
osource "/home/hadoop/zephyresp/zephyr/soc/nxp/imxrt/Kconfig"
osource "/home/hadoop/zephyresp/zephyr/soc/nxp/imx/Kconfig"
osource "/home/hadoop/zephyresp/zephyr/soc/nuvoton/numicro/Kconfig"
osource "/home/hadoop/zephyresp/zephyr/soc/nuvoton/numaker/Kconfig"
osource "/home/hadoop/zephyresp/zephyr/soc/nuvoton/npcx/Kconfig"
osource "/home/hadoop/zephyresp/zephyr/soc/nuvoton/npcm/Kconfig"
osource "/home/hadoop/zephyresp/zephyr/soc/nordic/Kconfig"
osource "/home/hadoop/zephyresp/zephyr/soc/neorv32/Kconfig"
osource "/home/hadoop/zephyresp/zephyr/soc/native/inf_clock/Kconfig"
osource "/home/hadoop/zephyresp/zephyr/soc/microchip/sam/sama7/Kconfig"
osource "/home/hadoop/zephyresp/zephyr/soc/microchip/sam/sam_d5x_e5x/Kconfig"
osource "/home/hadoop/zephyresp/zephyr/soc/microchip/pic64/Kconfig"
osource "/home/hadoop/zephyresp/zephyr/soc/microchip/pic32c/pic32cz_ca/Kconfig"
osource "/home/hadoop/zephyresp/zephyr/soc/microchip/pic32c/pic32cx_sg/Kconfig"
osource "/home/hadoop/zephyresp/zephyr/soc/microchip/pic32c/pic32cm_pl/Kconfig"
osource "/home/hadoop/zephyresp/zephyr/soc/microchip/pic32c/pic32cm_jh/Kconfig"
osource "/home/hadoop/zephyresp/zephyr/soc/microchip/miv/Kconfig"
osource "/home/hadoop/zephyresp/zephyr/soc/microchip/mec/Kconfig"
osource "/home/hadoop/zephyresp/zephyr/soc/mediatek/mt8xxx/Kconfig"
osource "/home/hadoop/zephyresp/zephyr/soc/lowrisc/opentitan/Kconfig"
osource "/home/hadoop/zephyresp/zephyr/soc/litex/litex_vexriscv/Kconfig"
osource "/home/hadoop/zephyresp/zephyr/soc/ite/ec/Kconfig"
osource "/home/hadoop/zephyresp/zephyr/soc/intel/wildcat_lake/Kconfig"
osource "/home/hadoop/zephyresp/zephyr/soc/intel/raptor_lake/Kconfig"
osource "/home/hadoop/zephyresp/zephyr/soc/intel/panther_lake/Kconfig"
osource "/home/hadoop/zephyresp/zephyr/soc/intel/lakemont/Kconfig"
osource "/home/hadoop/zephyresp/zephyr/soc/intel/intel_socfpga_std/Kconfig"
osource "/home/hadoop/zephyresp/zephyr/soc/intel/intel_socfpga/Kconfig"
osource "/home/hadoop/zephyresp/zephyr/soc/intel/intel_niosv/Kconfig"
osource "/home/hadoop/zephyresp/zephyr/soc/intel/intel_ish/Kconfig"
osource "/home/hadoop/zephyresp/zephyr/soc/intel/intel_adsp/Kconfig"
osource "/home/hadoop/zephyresp/zephyr/soc/intel/elkhart_lake/Kconfig"
osource "/home/hadoop/zephyresp/zephyr/soc/intel/atom/Kconfig"
osource "/home/hadoop/zephyresp/zephyr/soc/intel/apollo_lake/Kconfig"
osource "/home/hadoop/zephyresp/zephyr/soc/intel/alder_lake/Kconfig"
osource "/home/hadoop/zephyresp/zephyr/soc/infineon/psoc4/Kconfig"
osource "/home/hadoop/zephyresp/zephyr/soc/infineon/edge/Kconfig"
osource "/home/hadoop/zephyresp/zephyr/soc/infineon/cat3/Kconfig"
osource "/home/hadoop/zephyresp/zephyr/soc/infineon/cat1c/Kconfig"
osource "/home/hadoop/zephyresp/zephyr/soc/infineon/cat1b/Kconfig"
osource "/home/hadoop/zephyresp/zephyr/soc/infineon/cat1a/Kconfig"
osource "/home/hadoop/zephyresp/zephyr/soc/gd/gd32/Kconfig"
osource "/home/hadoop/zephyresp/zephyr/soc/gaisler/leon3/Kconfig"
osource "/home/hadoop/zephyresp/zephyr/soc/gaisler/gr716a/Kconfig"
osource "/home/hadoop/zephyresp/zephyr/soc/focaltech/Kconfig"
osource "/home/hadoop/zephyresp/zephyr/soc/espressif/Kconfig"
osource "/home/hadoop/zephyresp/zephyr/soc/ene/kb1200/Kconfig"
osource "/home/hadoop/zephyresp/zephyr/soc/ene/kb106x/Kconfig"
osource "/home/hadoop/zephyresp/zephyr/soc/elan/em32f967/Kconfig"
osource "/home/hadoop/zephyresp/zephyr/soc/egis/Kconfig"
osource "/home/hadoop/zephyresp/zephyr/soc/efinix/sapphire/Kconfig"
osource "/home/hadoop/zephyresp/zephyr/soc/cdns/xtensa_sample_controller/Kconfig"
osource "/home/hadoop/zephyresp/zephyr/soc/cdns/swerv/Kconfig"
osource "/home/hadoop/zephyresp/zephyr/soc/cdns/sample_controller32/Kconfig"
osource "/home/hadoop/zephyresp/zephyr/soc/cdns/dc233c/Kconfig"
osource "/home/hadoop/zephyresp/zephyr/soc/brcm/bcmvk/Kconfig"
osource "/home/hadoop/zephyresp/zephyr/soc/brcm/bcm2712/Kconfig"
osource "/home/hadoop/zephyresp/zephyr/soc/brcm/bcm2711/Kconfig"
osource "/home/hadoop/zephyresp/zephyr/soc/blackberry/qnxhv_vm/Kconfig"
osource "/home/hadoop/zephyresp/zephyr/soc/bflb/Kconfig"
osource "/home/hadoop/zephyresp/zephyr/soc/atmel/sam0/Kconfig"
osource "/home/hadoop/zephyresp/zephyr/soc/atmel/sam/Kconfig"
osource "/home/hadoop/zephyresp/zephyr/soc/aspeed/Kconfig"
osource "/home/hadoop/zephyresp/zephyr/soc/arm/Kconfig"
osource "/home/hadoop/zephyresp/zephyr/soc/arm/beetle/Kconfig"
osource "/home/hadoop/zephyresp/zephyr/soc/antmicro/myra/Kconfig"
osource "/home/hadoop/zephyresp/zephyr/soc/andestech/Kconfig"
osource "/home/hadoop/zephyresp/zephyr/soc/amd/acp_6_0/Kconfig"
osource "/home/hadoop/zephyresp/zephyr/soc/ambiq/Kconfig"
osource "/home/hadoop/zephyresp/zephyr/soc/allwinner/sun8i_h3/Kconfig"
osource "/home/hadoop/zephyresp/zephyr/soc/alif/ensemble/Kconfig"
osource "/home/hadoop/zephyresp/zephyr/soc/aesc/Kconfig"
osource "/home/hadoop/zephyresp/zephyr/soc/adi/max32/Kconfig"
```
