## peripheral/build/Kconfig/soc/Kconfig.sysbuild
```kconfig
# Load Sysbuild SoC Kconfig descriptions.
osource "/home/hadoop/zephyresp/zephyr/soc/xlnx/zynqmp/Kconfig.sysbuild"
osource "/home/hadoop/zephyresp/zephyr/soc/xlnx/zynq7000/Kconfig.sysbuild"
osource "/home/hadoop/zephyresp/zephyr/soc/xlnx/versalnet/Kconfig.sysbuild"
osource "/home/hadoop/zephyresp/zephyr/soc/xlnx/versal2/Kconfig.sysbuild"
osource "/home/hadoop/zephyresp/zephyr/soc/xlnx/versal/Kconfig.sysbuild"
osource "/home/hadoop/zephyresp/zephyr/soc/xen/Kconfig.sysbuild"
osource "/home/hadoop/zephyresp/zephyr/soc/wch/ch32v/Kconfig.sysbuild"
osource "/home/hadoop/zephyresp/zephyr/soc/ti/simplelink/Kconfig.sysbuild"
osource "/home/hadoop/zephyresp/zephyr/soc/ti/mspm0/Kconfig.sysbuild"
osource "/home/hadoop/zephyresp/zephyr/soc/ti/lm3s6965/Kconfig.sysbuild"
osource "/home/hadoop/zephyresp/zephyr/soc/ti/k3/Kconfig.sysbuild"
osource "/home/hadoop/zephyresp/zephyr/soc/telink/tlsr/Kconfig.sysbuild"
osource "/home/hadoop/zephyresp/zephyr/soc/syna/sr100/Kconfig.sysbuild"
osource "/home/hadoop/zephyresp/zephyr/soc/starfive/jh71xx/Kconfig.sysbuild"
osource "/home/hadoop/zephyresp/zephyr/soc/st/stm32/Kconfig.sysbuild"
osource "/home/hadoop/zephyresp/zephyr/soc/snps/qemu_arc/Kconfig.sysbuild"
osource "/home/hadoop/zephyresp/zephyr/soc/snps/nsim/arc_v/Kconfig.sysbuild"
osource "/home/hadoop/zephyresp/zephyr/soc/snps/nsim/arc_classic/Kconfig.sysbuild"
osource "/home/hadoop/zephyresp/zephyr/soc/snps/hsdk4xd/Kconfig.sysbuild"
osource "/home/hadoop/zephyresp/zephyr/soc/snps/hsdk/Kconfig.sysbuild"
osource "/home/hadoop/zephyresp/zephyr/soc/snps/emsk/Kconfig.sysbuild"
osource "/home/hadoop/zephyresp/zephyr/soc/snps/emsdp/Kconfig.sysbuild"
osource "/home/hadoop/zephyresp/zephyr/soc/snps/arc_iot/Kconfig.sysbuild"
osource "/home/hadoop/zephyresp/zephyr/soc/silabs/Kconfig.sysbuild"
osource "/home/hadoop/zephyresp/zephyr/soc/sifli/sf32/Kconfig.sysbuild"
osource "/home/hadoop/zephyresp/zephyr/soc/sifive/sifive_freedom/Kconfig.sysbuild"
osource "/home/hadoop/zephyresp/zephyr/soc/sensry/Kconfig.sysbuild"
osource "/home/hadoop/zephyresp/zephyr/soc/rockchip/Kconfig.sysbuild"
osource "/home/hadoop/zephyresp/zephyr/soc/renode/riscv_virtual/Kconfig.sysbuild"
osource "/home/hadoop/zephyresp/zephyr/soc/renode/cortex_r8_virtual/Kconfig.sysbuild"
osource "/home/hadoop/zephyresp/zephyr/soc/renesas/smartbond/Kconfig.sysbuild"
osource "/home/hadoop/zephyresp/zephyr/soc/renesas/rz/Kconfig.sysbuild"
osource "/home/hadoop/zephyresp/zephyr/soc/renesas/rx/Kconfig.sysbuild"
osource "/home/hadoop/zephyresp/zephyr/soc/renesas/rcar/Kconfig.sysbuild"
osource "/home/hadoop/zephyresp/zephyr/soc/renesas/ra/Kconfig.sysbuild"
osource "/home/hadoop/zephyresp/zephyr/soc/realtek/fingerprint/Kconfig.sysbuild"
osource "/home/hadoop/zephyresp/zephyr/soc/realtek/ec/Kconfig.sysbuild"
osource "/home/hadoop/zephyresp/zephyr/soc/realtek/bee/Kconfig.sysbuild"
osource "/home/hadoop/zephyresp/zephyr/soc/realtek/ameba/Kconfig.sysbuild"
osource "/home/hadoop/zephyresp/zephyr/soc/raspberrypi/rpi_pico/Kconfig.sysbuild"
osource "/home/hadoop/zephyresp/zephyr/soc/quicklogic/eos_s3/Kconfig.sysbuild"
osource "/home/hadoop/zephyresp/zephyr/soc/qemu/virt_riscv/Kconfig.sysbuild"
osource "/home/hadoop/zephyresp/zephyr/soc/qemu/or1k/Kconfig.sysbuild"
osource "/home/hadoop/zephyresp/zephyr/soc/qemu/malta/Kconfig.sysbuild"
osource "/home/hadoop/zephyresp/zephyr/soc/openisa/rv32m1/Kconfig.sysbuild"
osource "/home/hadoop/zephyresp/zephyr/soc/openhwgroup/cva6/Kconfig.sysbuild"
osource "/home/hadoop/zephyresp/zephyr/soc/oct/osd32mp15x/Kconfig.sysbuild"
osource "/home/hadoop/zephyresp/zephyr/soc/nxp/s32/Kconfig.sysbuild"
osource "/home/hadoop/zephyresp/zephyr/soc/nxp/rw/Kconfig.sysbuild"
osource "/home/hadoop/zephyresp/zephyr/soc/nxp/mcx/Kconfig.sysbuild"
osource "/home/hadoop/zephyresp/zephyr/soc/nxp/lpc/Kconfig.sysbuild"
osource "/home/hadoop/zephyresp/zephyr/soc/nxp/layerscape/Kconfig.sysbuild"
osource "/home/hadoop/zephyresp/zephyr/soc/nxp/kinetis/Kconfig.sysbuild"
osource "/home/hadoop/zephyresp/zephyr/soc/nxp/imxrt/Kconfig.sysbuild"
osource "/home/hadoop/zephyresp/zephyr/soc/nxp/imx/Kconfig.sysbuild"
osource "/home/hadoop/zephyresp/zephyr/soc/nuvoton/numicro/Kconfig.sysbuild"
osource "/home/hadoop/zephyresp/zephyr/soc/nuvoton/numaker/Kconfig.sysbuild"
osource "/home/hadoop/zephyresp/zephyr/soc/nuvoton/npcx/Kconfig.sysbuild"
osource "/home/hadoop/zephyresp/zephyr/soc/nuvoton/npcm/Kconfig.sysbuild"
osource "/home/hadoop/zephyresp/zephyr/soc/nordic/Kconfig.sysbuild"
osource "/home/hadoop/zephyresp/zephyr/soc/neorv32/Kconfig.sysbuild"
osource "/home/hadoop/zephyresp/zephyr/soc/native/inf_clock/Kconfig.sysbuild"
osource "/home/hadoop/zephyresp/zephyr/soc/microchip/sam/sama7/Kconfig.sysbuild"
osource "/home/hadoop/zephyresp/zephyr/soc/microchip/sam/sam_d5x_e5x/Kconfig.sysbuild"
osource "/home/hadoop/zephyresp/zephyr/soc/microchip/pic64/Kconfig.sysbuild"
osource "/home/hadoop/zephyresp/zephyr/soc/microchip/pic32c/pic32cz_ca/Kconfig.sysbuild"
osource "/home/hadoop/zephyresp/zephyr/soc/microchip/pic32c/pic32cx_sg/Kconfig.sysbuild"
osource "/home/hadoop/zephyresp/zephyr/soc/microchip/pic32c/pic32cm_pl/Kconfig.sysbuild"
osource "/home/hadoop/zephyresp/zephyr/soc/microchip/pic32c/pic32cm_jh/Kconfig.sysbuild"
osource "/home/hadoop/zephyresp/zephyr/soc/microchip/miv/Kconfig.sysbuild"
osource "/home/hadoop/zephyresp/zephyr/soc/microchip/mec/Kconfig.sysbuild"
osource "/home/hadoop/zephyresp/zephyr/soc/mediatek/mt8xxx/Kconfig.sysbuild"
osource "/home/hadoop/zephyresp/zephyr/soc/lowrisc/opentitan/Kconfig.sysbuild"
osource "/home/hadoop/zephyresp/zephyr/soc/litex/litex_vexriscv/Kconfig.sysbuild"
osource "/home/hadoop/zephyresp/zephyr/soc/ite/ec/Kconfig.sysbuild"
osource "/home/hadoop/zephyresp/zephyr/soc/intel/wildcat_lake/Kconfig.sysbuild"
osource "/home/hadoop/zephyresp/zephyr/soc/intel/raptor_lake/Kconfig.sysbuild"
osource "/home/hadoop/zephyresp/zephyr/soc/intel/panther_lake/Kconfig.sysbuild"
osource "/home/hadoop/zephyresp/zephyr/soc/intel/lakemont/Kconfig.sysbuild"
osource "/home/hadoop/zephyresp/zephyr/soc/intel/intel_socfpga_std/Kconfig.sysbuild"
osource "/home/hadoop/zephyresp/zephyr/soc/intel/intel_socfpga/Kconfig.sysbuild"
osource "/home/hadoop/zephyresp/zephyr/soc/intel/intel_niosv/Kconfig.sysbuild"
osource "/home/hadoop/zephyresp/zephyr/soc/intel/intel_ish/Kconfig.sysbuild"
osource "/home/hadoop/zephyresp/zephyr/soc/intel/intel_adsp/Kconfig.sysbuild"
osource "/home/hadoop/zephyresp/zephyr/soc/intel/elkhart_lake/Kconfig.sysbuild"
osource "/home/hadoop/zephyresp/zephyr/soc/intel/atom/Kconfig.sysbuild"
osource "/home/hadoop/zephyresp/zephyr/soc/intel/apollo_lake/Kconfig.sysbuild"
osource "/home/hadoop/zephyresp/zephyr/soc/intel/alder_lake/Kconfig.sysbuild"
osource "/home/hadoop/zephyresp/zephyr/soc/infineon/psoc4/Kconfig.sysbuild"
osource "/home/hadoop/zephyresp/zephyr/soc/infineon/edge/Kconfig.sysbuild"
osource "/home/hadoop/zephyresp/zephyr/soc/infineon/cat3/Kconfig.sysbuild"
osource "/home/hadoop/zephyresp/zephyr/soc/infineon/cat1c/Kconfig.sysbuild"
osource "/home/hadoop/zephyresp/zephyr/soc/infineon/cat1b/Kconfig.sysbuild"
osource "/home/hadoop/zephyresp/zephyr/soc/infineon/cat1a/Kconfig.sysbuild"
osource "/home/hadoop/zephyresp/zephyr/soc/gd/gd32/Kconfig.sysbuild"
osource "/home/hadoop/zephyresp/zephyr/soc/gaisler/leon3/Kconfig.sysbuild"
osource "/home/hadoop/zephyresp/zephyr/soc/gaisler/gr716a/Kconfig.sysbuild"
osource "/home/hadoop/zephyresp/zephyr/soc/focaltech/Kconfig.sysbuild"
osource "/home/hadoop/zephyresp/zephyr/soc/espressif/Kconfig.sysbuild"
osource "/home/hadoop/zephyresp/zephyr/soc/ene/kb1200/Kconfig.sysbuild"
osource "/home/hadoop/zephyresp/zephyr/soc/ene/kb106x/Kconfig.sysbuild"
osource "/home/hadoop/zephyresp/zephyr/soc/elan/em32f967/Kconfig.sysbuild"
osource "/home/hadoop/zephyresp/zephyr/soc/egis/Kconfig.sysbuild"
osource "/home/hadoop/zephyresp/zephyr/soc/efinix/sapphire/Kconfig.sysbuild"
osource "/home/hadoop/zephyresp/zephyr/soc/cdns/xtensa_sample_controller/Kconfig.sysbuild"
osource "/home/hadoop/zephyresp/zephyr/soc/cdns/swerv/Kconfig.sysbuild"
osource "/home/hadoop/zephyresp/zephyr/soc/cdns/sample_controller32/Kconfig.sysbuild"
osource "/home/hadoop/zephyresp/zephyr/soc/cdns/dc233c/Kconfig.sysbuild"
osource "/home/hadoop/zephyresp/zephyr/soc/brcm/bcmvk/Kconfig.sysbuild"
osource "/home/hadoop/zephyresp/zephyr/soc/brcm/bcm2712/Kconfig.sysbuild"
osource "/home/hadoop/zephyresp/zephyr/soc/brcm/bcm2711/Kconfig.sysbuild"
osource "/home/hadoop/zephyresp/zephyr/soc/blackberry/qnxhv_vm/Kconfig.sysbuild"
osource "/home/hadoop/zephyresp/zephyr/soc/bflb/Kconfig.sysbuild"
osource "/home/hadoop/zephyresp/zephyr/soc/atmel/sam0/Kconfig.sysbuild"
osource "/home/hadoop/zephyresp/zephyr/soc/atmel/sam/Kconfig.sysbuild"
osource "/home/hadoop/zephyresp/zephyr/soc/aspeed/Kconfig.sysbuild"
osource "/home/hadoop/zephyresp/zephyr/soc/arm/Kconfig.sysbuild"
osource "/home/hadoop/zephyresp/zephyr/soc/arm/beetle/Kconfig.sysbuild"
osource "/home/hadoop/zephyresp/zephyr/soc/antmicro/myra/Kconfig.sysbuild"
osource "/home/hadoop/zephyresp/zephyr/soc/andestech/Kconfig.sysbuild"
osource "/home/hadoop/zephyresp/zephyr/soc/amd/acp_6_0/Kconfig.sysbuild"
osource "/home/hadoop/zephyresp/zephyr/soc/ambiq/Kconfig.sysbuild"
osource "/home/hadoop/zephyresp/zephyr/soc/allwinner/sun8i_h3/Kconfig.sysbuild"
osource "/home/hadoop/zephyresp/zephyr/soc/alif/ensemble/Kconfig.sysbuild"
osource "/home/hadoop/zephyresp/zephyr/soc/aesc/Kconfig.sysbuild"
osource "/home/hadoop/zephyresp/zephyr/soc/adi/max32/Kconfig.sysbuild"
```
