## peripheral/build/Kconfig/arch/Kconfig
```kconfig
# Load Zephyr Arch Kconfig descriptions.
osource "/home/hadoop/zephyresp/zephyr/arch/rx/Kconfig"
osource "/home/hadoop/zephyresp/zephyr/arch/x86/Kconfig"
osource "/home/hadoop/zephyresp/zephyr/arch/xtensa/Kconfig"
osource "/home/hadoop/zephyresp/zephyr/arch/sparc/Kconfig"
osource "/home/hadoop/zephyresp/zephyr/arch/riscv/Kconfig"
osource "/home/hadoop/zephyresp/zephyr/arch/posix/Kconfig"
osource "/home/hadoop/zephyresp/zephyr/arch/openrisc/Kconfig"
osource "/home/hadoop/zephyresp/zephyr/arch/mips/Kconfig"
osource "/home/hadoop/zephyresp/zephyr/arch/arm64/Kconfig"
osource "/home/hadoop/zephyresp/zephyr/arch/arm/Kconfig"
osource "/home/hadoop/zephyresp/zephyr/arch/arc/Kconfig"
```

## peripheral/build/Kconfig/boards/Kconfig
```kconfig
# Load Zephyr board Kconfig descriptions.
osource "/home/hadoop/zephyresp/zephyr/boards/arduino/nano_33_ble/Kconfig"
```

## peripheral/build/Kconfig/boards/Kconfig.defconfig
```kconfig
# Load Zephyr board defconfig descriptions.
osource "/home/hadoop/zephyresp/zephyr/boards/arduino/nano_33_ble/Kconfig.defconfig"
```

## peripheral/build/Kconfig/soc/Kconfig.defconfig
```kconfig
# Load Zephyr SoC defconfig descriptions.
osource "/home/hadoop/zephyresp/zephyr/soc/xlnx/zynqmp/Kconfig.defconfig"
osource "/home/hadoop/zephyresp/zephyr/soc/xlnx/zynq7000/Kconfig.defconfig"
osource "/home/hadoop/zephyresp/zephyr/soc/xlnx/versalnet/Kconfig.defconfig"
osource "/home/hadoop/zephyresp/zephyr/soc/xlnx/versal2/Kconfig.defconfig"
osource "/home/hadoop/zephyresp/zephyr/soc/xlnx/versal/Kconfig.defconfig"
osource "/home/hadoop/zephyresp/zephyr/soc/xen/Kconfig.defconfig"
osource "/home/hadoop/zephyresp/zephyr/soc/wch/ch32v/Kconfig.defconfig"
osource "/home/hadoop/zephyresp/zephyr/soc/ti/simplelink/Kconfig.defconfig"
osource "/home/hadoop/zephyresp/zephyr/soc/ti/mspm0/Kconfig.defconfig"
osource "/home/hadoop/zephyresp/zephyr/soc/ti/lm3s6965/Kconfig.defconfig"
osource "/home/hadoop/zephyresp/zephyr/soc/ti/k3/Kconfig.defconfig"
osource "/home/hadoop/zephyresp/zephyr/soc/telink/tlsr/Kconfig.defconfig"
osource "/home/hadoop/zephyresp/zephyr/soc/syna/sr100/Kconfig.defconfig"
osource "/home/hadoop/zephyresp/zephyr/soc/starfive/jh71xx/Kconfig.defconfig"
osource "/home/hadoop/zephyresp/zephyr/soc/st/stm32/Kconfig.defconfig"
osource "/home/hadoop/zephyresp/zephyr/soc/snps/qemu_arc/Kconfig.defconfig"
osource "/home/hadoop/zephyresp/zephyr/soc/snps/nsim/arc_v/Kconfig.defconfig"
osource "/home/hadoop/zephyresp/zephyr/soc/snps/nsim/arc_classic/Kconfig.defconfig"
osource "/home/hadoop/zephyresp/zephyr/soc/snps/hsdk4xd/Kconfig.defconfig"
osource "/home/hadoop/zephyresp/zephyr/soc/snps/hsdk/Kconfig.defconfig"
osource "/home/hadoop/zephyresp/zephyr/soc/snps/emsk/Kconfig.defconfig"
osource "/home/hadoop/zephyresp/zephyr/soc/snps/emsdp/Kconfig.defconfig"
osource "/home/hadoop/zephyresp/zephyr/soc/snps/arc_iot/Kconfig.defconfig"
osource "/home/hadoop/zephyresp/zephyr/soc/silabs/Kconfig.defconfig"
osource "/home/hadoop/zephyresp/zephyr/soc/sifli/sf32/Kconfig.defconfig"
osource "/home/hadoop/zephyresp/zephyr/soc/sifive/sifive_freedom/Kconfig.defconfig"
osource "/home/hadoop/zephyresp/zephyr/soc/sensry/Kconfig.defconfig"
osource "/home/hadoop/zephyresp/zephyr/soc/rockchip/Kconfig.defconfig"
osource "/home/hadoop/zephyresp/zephyr/soc/renode/riscv_virtual/Kconfig.defconfig"
osource "/home/hadoop/zephyresp/zephyr/soc/renode/cortex_r8_virtual/Kconfig.defconfig"
osource "/home/hadoop/zephyresp/zephyr/soc/renesas/smartbond/Kconfig.defconfig"
osource "/home/hadoop/zephyresp/zephyr/soc/renesas/rz/Kconfig.defconfig"
osource "/home/hadoop/zephyresp/zephyr/soc/renesas/rx/Kconfig.defconfig"
osource "/home/hadoop/zephyresp/zephyr/soc/renesas/rcar/Kconfig.defconfig"
osource "/home/hadoop/zephyresp/zephyr/soc/renesas/ra/Kconfig.defconfig"
osource "/home/hadoop/zephyresp/zephyr/soc/realtek/fingerprint/Kconfig.defconfig"
osource "/home/hadoop/zephyresp/zephyr/soc/realtek/ec/Kconfig.defconfig"
osource "/home/hadoop/zephyresp/zephyr/soc/realtek/bee/Kconfig.defconfig"
osource "/home/hadoop/zephyresp/zephyr/soc/realtek/ameba/Kconfig.defconfig"
osource "/home/hadoop/zephyresp/zephyr/soc/raspberrypi/rpi_pico/Kconfig.defconfig"
osource "/home/hadoop/zephyresp/zephyr/soc/quicklogic/eos_s3/Kconfig.defconfig"
osource "/home/hadoop/zephyresp/zephyr/soc/qemu/virt_riscv/Kconfig.defconfig"
osource "/home/hadoop/zephyresp/zephyr/soc/qemu/or1k/Kconfig.defconfig"
osource "/home/hadoop/zephyresp/zephyr/soc/qemu/malta/Kconfig.defconfig"
osource "/home/hadoop/zephyresp/zephyr/soc/openisa/rv32m1/Kconfig.defconfig"
osource "/home/hadoop/zephyresp/zephyr/soc/openhwgroup/cva6/Kconfig.defconfig"
osource "/home/hadoop/zephyresp/zephyr/soc/oct/osd32mp15x/Kconfig.defconfig"
osource "/home/hadoop/zephyresp/zephyr/soc/nxp/s32/Kconfig.defconfig"
osource "/home/hadoop/zephyresp/zephyr/soc/nxp/rw/Kconfig.defconfig"
osource "/home/hadoop/zephyresp/zephyr/soc/nxp/mcx/Kconfig.defconfig"
osource "/home/hadoop/zephyresp/zephyr/soc/nxp/lpc/Kconfig.defconfig"
osource "/home/hadoop/zephyresp/zephyr/soc/nxp/layerscape/Kconfig.defconfig"
osource "/home/hadoop/zephyresp/zephyr/soc/nxp/kinetis/Kconfig.defconfig"
osource "/home/hadoop/zephyresp/zephyr/soc/nxp/imxrt/Kconfig.defconfig"
osource "/home/hadoop/zephyresp/zephyr/soc/nxp/imx/Kconfig.defconfig"
osource "/home/hadoop/zephyresp/zephyr/soc/nuvoton/numicro/Kconfig.defconfig"
osource "/home/hadoop/zephyresp/zephyr/soc/nuvoton/numaker/Kconfig.defconfig"
osource "/home/hadoop/zephyresp/zephyr/soc/nuvoton/npcx/Kconfig.defconfig"
osource "/home/hadoop/zephyresp/zephyr/soc/nuvoton/npcm/Kconfig.defconfig"
osource "/home/hadoop/zephyresp/zephyr/soc/nordic/Kconfig.defconfig"
osource "/home/hadoop/zephyresp/zephyr/soc/neorv32/Kconfig.defconfig"
osource "/home/hadoop/zephyresp/zephyr/soc/native/inf_clock/Kconfig.defconfig"
osource "/home/hadoop/zephyresp/zephyr/soc/microchip/sam/sama7/Kconfig.defconfig"
osource "/home/hadoop/zephyresp/zephyr/soc/microchip/sam/sam_d5x_e5x/Kconfig.defconfig"
osource "/home/hadoop/zephyresp/zephyr/soc/microchip/pic64/Kconfig.defconfig"
osource "/home/hadoop/zephyresp/zephyr/soc/microchip/pic32c/pic32cz_ca/Kconfig.defconfig"
osource "/home/hadoop/zephyresp/zephyr/soc/microchip/pic32c/pic32cx_sg/Kconfig.defconfig"
osource "/home/hadoop/zephyresp/zephyr/soc/microchip/pic32c/pic32cm_pl/Kconfig.defconfig"
osource "/home/hadoop/zephyresp/zephyr/soc/microchip/pic32c/pic32cm_jh/Kconfig.defconfig"
osource "/home/hadoop/zephyresp/zephyr/soc/microchip/miv/Kconfig.defconfig"
osource "/home/hadoop/zephyresp/zephyr/soc/microchip/mec/Kconfig.defconfig"
osource "/home/hadoop/zephyresp/zephyr/soc/mediatek/mt8xxx/Kconfig.defconfig"
osource "/home/hadoop/zephyresp/zephyr/soc/lowrisc/opentitan/Kconfig.defconfig"
osource "/home/hadoop/zephyresp/zephyr/soc/litex/litex_vexriscv/Kconfig.defconfig"
osource "/home/hadoop/zephyresp/zephyr/soc/ite/ec/Kconfig.defconfig"
osource "/home/hadoop/zephyresp/zephyr/soc/intel/wildcat_lake/Kconfig.defconfig"
osource "/home/hadoop/zephyresp/zephyr/soc/intel/raptor_lake/Kconfig.defconfig"
osource "/home/hadoop/zephyresp/zephyr/soc/intel/panther_lake/Kconfig.defconfig"
osource "/home/hadoop/zephyresp/zephyr/soc/intel/lakemont/Kconfig.defconfig"
osource "/home/hadoop/zephyresp/zephyr/soc/intel/intel_socfpga_std/Kconfig.defconfig"
osource "/home/hadoop/zephyresp/zephyr/soc/intel/intel_socfpga/Kconfig.defconfig"
osource "/home/hadoop/zephyresp/zephyr/soc/intel/intel_niosv/Kconfig.defconfig"
osource "/home/hadoop/zephyresp/zephyr/soc/intel/intel_ish/Kconfig.defconfig"
osource "/home/hadoop/zephyresp/zephyr/soc/intel/intel_adsp/Kconfig.defconfig"
osource "/home/hadoop/zephyresp/zephyr/soc/intel/elkhart_lake/Kconfig.defconfig"
osource "/home/hadoop/zephyresp/zephyr/soc/intel/atom/Kconfig.defconfig"
osource "/home/hadoop/zephyresp/zephyr/soc/intel/apollo_lake/Kconfig.defconfig"
osource "/home/hadoop/zephyresp/zephyr/soc/intel/alder_lake/Kconfig.defconfig"
osource "/home/hadoop/zephyresp/zephyr/soc/infineon/psoc4/Kconfig.defconfig"
osource "/home/hadoop/zephyresp/zephyr/soc/infineon/edge/Kconfig.defconfig"
osource "/home/hadoop/zephyresp/zephyr/soc/infineon/cat3/Kconfig.defconfig"
osource "/home/hadoop/zephyresp/zephyr/soc/infineon/cat1c/Kconfig.defconfig"
osource "/home/hadoop/zephyresp/zephyr/soc/infineon/cat1b/Kconfig.defconfig"
osource "/home/hadoop/zephyresp/zephyr/soc/infineon/cat1a/Kconfig.defconfig"
osource "/home/hadoop/zephyresp/zephyr/soc/gd/gd32/Kconfig.defconfig"
osource "/home/hadoop/zephyresp/zephyr/soc/gaisler/leon3/Kconfig.defconfig"
osource "/home/hadoop/zephyresp/zephyr/soc/gaisler/gr716a/Kconfig.defconfig"
osource "/home/hadoop/zephyresp/zephyr/soc/focaltech/Kconfig.defconfig"
osource "/home/hadoop/zephyresp/zephyr/soc/espressif/Kconfig.defconfig"
osource "/home/hadoop/zephyresp/zephyr/soc/ene/kb1200/Kconfig.defconfig"
osource "/home/hadoop/zephyresp/zephyr/soc/ene/kb106x/Kconfig.defconfig"
osource "/home/hadoop/zephyresp/zephyr/soc/elan/em32f967/Kconfig.defconfig"
osource "/home/hadoop/zephyresp/zephyr/soc/egis/Kconfig.defconfig"
osource "/home/hadoop/zephyresp/zephyr/soc/efinix/sapphire/Kconfig.defconfig"
osource "/home/hadoop/zephyresp/zephyr/soc/cdns/xtensa_sample_controller/Kconfig.defconfig"
osource "/home/hadoop/zephyresp/zephyr/soc/cdns/swerv/Kconfig.defconfig"
osource "/home/hadoop/zephyresp/zephyr/soc/cdns/sample_controller32/Kconfig.defconfig"
osource "/home/hadoop/zephyresp/zephyr/soc/cdns/dc233c/Kconfig.defconfig"
osource "/home/hadoop/zephyresp/zephyr/soc/brcm/bcmvk/Kconfig.defconfig"
osource "/home/hadoop/zephyresp/zephyr/soc/brcm/bcm2712/Kconfig.defconfig"
osource "/home/hadoop/zephyresp/zephyr/soc/brcm/bcm2711/Kconfig.defconfig"
osource "/home/hadoop/zephyresp/zephyr/soc/blackberry/qnxhv_vm/Kconfig.defconfig"
osource "/home/hadoop/zephyresp/zephyr/soc/bflb/Kconfig.defconfig"
osource "/home/hadoop/zephyresp/zephyr/soc/atmel/sam0/Kconfig.defconfig"
osource "/home/hadoop/zephyresp/zephyr/soc/atmel/sam/Kconfig.defconfig"
osource "/home/hadoop/zephyresp/zephyr/soc/aspeed/Kconfig.defconfig"
osource "/home/hadoop/zephyresp/zephyr/soc/arm/Kconfig.defconfig"
osource "/home/hadoop/zephyresp/zephyr/soc/arm/beetle/Kconfig.defconfig"
osource "/home/hadoop/zephyresp/zephyr/soc/antmicro/myra/Kconfig.defconfig"
osource "/home/hadoop/zephyresp/zephyr/soc/andestech/Kconfig.defconfig"
osource "/home/hadoop/zephyresp/zephyr/soc/amd/acp_6_0/Kconfig.defconfig"
osource "/home/hadoop/zephyresp/zephyr/soc/ambiq/Kconfig.defconfig"
osource "/home/hadoop/zephyresp/zephyr/soc/allwinner/sun8i_h3/Kconfig.defconfig"
osource "/home/hadoop/zephyresp/zephyr/soc/alif/ensemble/Kconfig.defconfig"
osource "/home/hadoop/zephyresp/zephyr/soc/aesc/Kconfig.defconfig"
osource "/home/hadoop/zephyresp/zephyr/soc/adi/max32/Kconfig.defconfig"
```
